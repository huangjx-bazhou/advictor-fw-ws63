## src/application/Kconfig
```kconfig
#===============================================================================
# @brief    Kconfig file.
# Copyright (c) HiSilicon (Shanghai) Technologies Co., Ltd. 2023-2023. All rights reserved.
#===============================================================================

choice
    prompt "Component"
    default ADVICTOR_ENABLE

    config ADVICTOR_ENABLE
        bool
        prompt "Enable advictor component."
        help
            This option means support advictor components.

    if ADVICTOR_ENABLE
        osource "application/advictor/Kconfig"
    endif

    config SAMPLE_ENABLE
        bool
        prompt "Enable Sample."
        help
            This option means support Samples.

    if SAMPLE_ENABLE
        osource "application/samples/Kconfig"
    endif

endchoice
```

## src/application/advictor/Kconfig
```kconfig
#===============================================================================
# @brief    Kconfig file.
# Copyright (c) HiSilicon (Shanghai) Technologies Co., Ltd. 2023-2023. All rights reserved.
#===============================================================================

config ENABLE_GATEWAY
    bool
    prompt "Enable gateway."
    default y
    depends on ADVICTOR_ENABLE
    help
        This option means enable the gateway.

if ENABLE_GATEWAY
    osource "application/advictor/gateway/Kconfig"
endif
```
